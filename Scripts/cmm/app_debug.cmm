; -------- Application Debugging --------------
;          (AutoLoader version)

; This script waits for an application to be started,
; loads the symbols and halts the application at main()

; NOTE: Linux and the Linux awareness must be up.

; Start this script with the process name as argument to
; run the script as command line version or use /dialog 
; to run the script in a dialog.

; Examples: 
;   do app_debug hello      ; waits for "hello" to be started
;   do app_debug /dialog    ; opens a dialog window

; Prerequisites:
; - Linux must be booted
; - Linux awareness must be configured
; - Symbol Autoloader must be configured


; Define local macros
 local  &para1 &process &dialog
 global &true &false &breakaddr
 &true=(1==1)
 &false=(1==0)
 &breakaddr=0
 
 
; Get the script parameter (process name or "/dialog")
 entry &para1


; Check parameters
 if "&para1"==""
 (
    ; no parameter given -> print usage
    print "Usage: ""do app_debug <processname>"" or ""do app_debug /dialog"""
    enddo
 )
 if string.lwr("&para1")=="/dialog"
 (
    ; /dialog -> open a dialog to select process
    &dialog=&true
    &process=""
 )
 else
 (
    ; parameter contains process name
    &dialog=&false
    &process="&para1"
 )
; limjh add  for test
;================================================
;
;	Setting up for Linux awareness
;
;================================================
;TASK.CONFIG C:\T32C\linux/linux.t32          ; loads Linux awareness (linux.t32)
;MENU.ReProgram C:\T32C\linux/linux.men       ; loads Linux menu (linux.men)
TASK.CONFIG C:\T32C\demo/arm/kernel/linux/linux.t32          ; loads Linux awareness (linux.t32)
MENU.ReProgram C:\T32C\demo/arm/kernel/linux/linux.men       ; loads Linux menu (linux.men)
HELP.FILTER.Add rtoslinux  	; add linux awareness manual to help filter

TASK.sYmbol.Option MMUSCAN OFF  ; not necessary with tablewalk

;sYmbol.AutoLoad.CHECKLINUX "do "+os.ppd()+"/autoload "
;sYmbol.AutoLoad.CHECKLINUX "C:\T32C\demo/arm/kernel/linux/autoload"
sYmbol.AutoLoad.CHECKLINUX "autoload"


; Group kernel area to be displayed with red bar
GROUP.Create "kernel" 0xc0000000--0xffffffff /RED

TASK.sYmbol.Option autoload process
TASK.sYmbol.Option autoload CurrLib

&kernel_dir="\\192.168.141.23\limjh\kernel"
Data.LOAD.Elf &kernel_dir/vmlinux /nocode /gnu /strippart 4. /path &kernel_dir
; limjh end
;================================================

; Check against TASK.Watch that interferes with this script
 if (task.watch.active()==1)
 (
    gosub message "Please close TASK.Watch window" "before using this menu item"
    enddo
 )


; Activate autoloader for processes:
 TASK.sYmbol.Option AutoLoad Process
 
; Ensure windows update
 screen.always


; Dialog or Command line version?

 if &dialog
   goto dialog
   

; ------------ Command line interface -----------

 ; Check if the process already exists in the process list.

 local &existed
 
 GOSUB checkexisting &process
 entry &existed
 if &existed
   enddo
   
 ; Wait for process to be loaded.
 ; The process must be started by executing it at the Linux console.

 print "Please start process &process..."
 GOSUB waitforstart &process &false

 ; Yep! The process is loaded and we found it.
 ; Now load the process symbols.

 print "process &process started, loading symbols..."
 GOSUB loadsymbols &process
 entry &main
 if &main==0
    enddo

 ; We got the main entry point of the process.
 ; We let the system run until it reaches main().

 print "waiting for reaching main..."
 GOSUB waitformain &process &main
 
 // That's it, we halted at main()!

 print "done."

 enddo
 
 
; ------------ Dialog interface -----------

dialog:
 dialog
 (
        header "Debug Process on main"
        pos 0. 0. 24. 3.
        box "process name"
        pos 1. 1. 22. 1.
proc:   defhotedit "" 
        (
            if dialog.string(proc)!=""
                dialog.enable bok
            else
                dialog.disable bok
        )
        pos 1. 3. 22. 1.
exec:   checkbox "send command to TERM window" ""
        pos 2. 4.5 8.
bok:    defbutton "Ok"
        (
            local &process
            dialog.disable bok
            dialog.disable proc
            &process=dialog.string(proc)
            dialog.set mess "Checking process &process..."
            
            GOSUB checkexisting &process
            entry &existed
            if &existed
                JUMPTO close

            dialog.set mess "Please start process &process"
            
            &exec=dialog.boolean(exec)
            GOSUB waitforstart &process &exec

            dialog.set mess "Process &process started. Loading symbols..."

            GOSUB loadsymbols &process
            entry &main
            if &main==0
                JUMPTO close

            dialog.set mess "Waiting for reaching main..."

            GOSUB waitformain &process &main
            
            JUMPTO close
        )
        pos 14. 4.5 8.
        button "Cancel" "JUMPTO close"
        pos 0. 6. 24. 1.
mess:   edit "Please enter process name" ""
        close "JUMPTO close"
 )

 dialog.disable bok
 dialog.disable mess

 stop

close:

 if &breakaddr!=0
 (
    if run()
        Break
    Break.Delete &breakaddr
    ON PBREAKAT &breakaddr
    &breakaddr=0
 )
 
 dialog.end
 enddo


; -------- Subroutine: Check if process already exists --------

checkexisting:
 entry &process

 if run()
    Break
    
 if task.proc.spaceid("&process")!=0xffffffff
 (
    sYmbol.AutoLOAD.CLEAR "&process"
    sYmbol.AutoLoad.CHECK
    sYmbol.AutoLOAD.TOUCH "&process"
    if y.exist(\\&process)
        gosub message "Process &process already running." "Symbols loaded."
    else
        gosub message "Process &process already running." "No symbol file found."
    return &true
 )

; Delete possibly existing breakpoints of previous process runs
 
 if y.exist("\\&process")
   Break.Delete y.secrange(\\&process\.text)

 return &false
 
 
; -------- Subroutine: Wait for start of process --------

waitforstart:
 entry &process &exec

; Wait for process to be loaded.
; The process must be started by executing it at the Linux console.

 // We cannot load process symbols as long as we don't
 // know the address translation. The MMU for the new
 // process is set up, right before set_binfmt() is called

 ; set_binfmt() is called for every process to start -
 ; the conditional breakpoint halts only, if the desired
 ; process is found in the process table.
 
 &breakaddr=address.offset(set_binfmt)
 Break.Delete &breakaddr                ; delete previous set breakpoints
 Break.Set &breakaddr /CONDition task.proc.spaceid("&process")!=0xffffffff
 
 ON PBREAKAT &breakaddr goto continue1  ; if breakpoint reached: continue
 Go         ; let the target run and load the process
 
 if &exec
    TERM.OUT "&process" 0x0a
 
 stop       ; halt script until breakpoint reached
 
 ; breakpoint hit, continue script
continue1:

 Break.Delete &breakaddr    // delete breakpoint
 ON PBREAKAT &breakaddr     // delete script action
 &breakaddr=0

 return


; -------- Subroutine: Load symbols of process --------

loadsymbols:
 entry &process

; Yep! The process is loaded and we found it.

; Now load the process symbols to the space id of the process

 sYmbol.AutoLOAD.CLEAR "&process"   ; clear possibly previous set
 sYmbol.AutoLoad.CHECK              ; force new autoloader list
 sYmbol.AutoLoad.TOUCH "&process"   ; force loading of process symbols
 

// Now set a breakpoint at it's main entry point.
 
 // NOTE: The code is still not available, so we MUST set 
 // onchip breakpoints, because those are the only ones
 // operating on virtual addresses

 // There may be more "main" symbols in the system,
 // we're searching for the right one.
 
 if y.count(\\&process\*\main)==0
 (
   ; try without filename extension
   &process=string.cut("&process",-string.len(os.file.extension("&process")))
   if y.count(\\&process\*\main)==0
   (
     gosub message "Symbol 'main' of process &process not found"
     return 0
   )
 )
   
 Eval 0
 sYmbol.ForEach "Eval address.offset(*)" \\&process\*\main
 &main=eval()              ; get address of main
 
 return &main
 
 
; -------- Subroutine: Wait for reaching main --------

waitformain:
 entry &process &main
 
 local &mainoffset
 
 if cpufamily()=="I386"
   &mainoffset=0        // we don't know the next instruction on x86...
 else if cpuis("NLXL*")
   &mainoffset=8        // NLXLR/S has 64bit mask on onchip breakpoints...
 else
   &mainoffset=4
 
 &breakaddr=&main+&mainoffset   // &mainoffset to let the page load (demand paging!)

 Break.Set &breakaddr /Onchip   ; set breakpoint on main

 ON PBREAKAT &breakaddr goto continue2  ; if breakpoint reached: continue
 Go         ; let the target run and start the process

 stop       ; halt script until breakpoint reached

 ; breakpoint hit, continue script
continue2: 
         
 Break.Delete &breakaddr    // delete breakpoint
 ON PBREAKAT &breakaddr     // delete script action
 &breakaddr=0

 ; reload process symbols to get correct address range
 
 sYmbol.AutoLoad.CHECK              ; force new autoloader list
 sYmbol.AutoLoad.TOUCH "&process"   ; force loading of process symbols

 return
 

; -------- Subroutine: print message in dialog box or command line --------

message:
 entry &msg1 &msg2
 if &dialog
    dialog.ok &msg1 &msg2
 else
    print &msg1 " " &msg2
 return
 
